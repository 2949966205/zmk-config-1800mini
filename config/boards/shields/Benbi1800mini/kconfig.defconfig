## config/boards/shields/Benbi1800mini/kconfig.defconfig
```kconfig
if SHIELD_BENBI1800MINI

config ZMK_KEYBOARD_NAME
    default "Benbi1800mini"

endif
```

## config/boards/shields/Benbi1800mini/kconfig.shield
```kconfig
config SHIELD_BENBI1800MINI
    def_bool $(shields_list-contains, Benbi1800mini)
```
